## M250_Nougat_Kernel/kernel-3.18/arch/arm/configs/lv7_debug_defconfig
```kconfig
CONFIG_IKCONFIG=y
CONFIG_IKCONFIG_PROC=y
CONFIG_CGROUP_DEBUG=y
CONFIG_SYSCTL_SYSCALL=y
CONFIG_CC_STACKPROTECTOR_REGULAR=y
CONFIG_CFG80211_DEBUGFS=y
CONFIG_MTK_NET_LOGGING=y
CONFIG_MT_ENG_BUILD=y
CONFIG_MTK_MMPROFILE_SUPPORT=y
CONFIG_MMPROFILE=y
CONFIG_MTK_MEMCFG=y
CONFIG_MTK_AEE_MRDUMP=y
CONFIG_MTK_WQ_DEBUG=y
CONFIG_MT_SCHED_MONITOR=y
CONFIG_MT_RT_THROTTLE_MON=y
CONFIG_PREEMPT_MONITOR=y
CONFIG_MT_SCHED_TRACE=y
CONFIG_DM_DEBUG=y
CONFIG_LGE_PANIC_ON_WDTK_RT_THROTTLING=y
CONFIG_EXT4_DEBUG=y
CONFIG_SLUB_DEBUG_PANIC_ON=y
# CONFIG_SLUB_DEBUG_ON is not set
CONFIG_DEBUG_KMEMLEAK=y
CONFIG_DEBUG_KMEMLEAK_EARLY_LOG_SIZE=3200
CONFIG_DEBUG_KMEMLEAK_DEFAULT_OFF=y
CONFIG_DETECT_HUNG_TASK=y
CONFIG_PANIC_TIMEOUT=5
CONFIG_DEBUG_SPINLOCK=y
CONFIG_DEBUG_MUTEXES=y
CONFIG_DEBUG_ATOMIC_SLEEP=y
CONFIG_DEBUG_LIST=y
CONFIG_RCU_TRACE=y
CONFIG_MTK_FTRACE_DEFAULT_ENABLE=y
CONFIG_DMA_API_DEBUG=y
CONFIG_KGDB=y
CONFIG_KGDB_KDB=y
CONFIG_MTK_SCHED_TRACERS=y
```

## M250_Nougat_Kernel/kernel-3.18/arch/arm/configs/lv7_global_com_common_defconfig
```kconfig
CONFIG_BUILD_ARM_APPENDED_DTB_IMAGE_NAMES="lv7_global_com"
CONFIG_LGE_BROADCAST_SBTVD_LATIN=y
```

## M250_Nougat_Kernel/kernel-3.18/arch/arm/configs/lv7_kt_kr_common_defconfig
```kconfig
CONFIG_BUILD_ARM_APPENDED_DTB_IMAGE_NAMES="lv7_kt_kr"
CONFIG_LGE_BROADCAST_TDMB=y
```

## M250_Nougat_Kernel/kernel-3.18/arch/arm/configs/lv7_skt_kr_common_defconfig
```kconfig
CONFIG_BUILD_ARM_APPENDED_DTB_IMAGE_NAMES="lv7_skt_kr"
CONFIG_LGE_BROADCAST_TDMB=y
```

## M250_Nougat_Kernel/kernel-3.18/arch/arm/configs/lv7_user_defconfig
```kconfig
################### DIFF with debug_defconfig from here  ###################
# CONFIG_SLUB_DEBUG is not set
# CONFIG_DEBUG_RODATA is not set
# CONFIG_DEVMEM is not set
# CONFIG_DEVKMEM is not set
# CONFIG_FUSE_IO_LOG is not set
CONFIG_MAGIC_SYSRQ=y
CONFIG_PANIC_TIMEOUT=1
# CONFIG_DEBUG_PREEMPT is not set
# CONFIG_DEBUG_BUGVERBOSE is not set
# CONFIG_MTK_LOCK_DEBUG is not set
# CONFIG_MTK_MLOG is not set
# CONFIG_MT_PRINTK_UART_CONSOLE is not set
# CONFIG_MT_BOOT_TIME_CPU_BOOST is not set
# CONFIG_SCHED_DEBUG is not set
# CONFIG_UEVENT_HELPER is not set
```

## M250_Nougat_Kernel/kernel-3.18/drivers/misc/mediatek/accelerometer/bma255-new/Kconfig
```kconfig
config MTK_BMA255_INT_ENABLE
	bool "BMA255 intterupt enable config"
	default n
	help
	  If this option is set,
	  it will support
	  BMA255 Interrupt function.
config MTK_BMA255_NEW
	bool "BMA255 for MediaTek package"
	default n
	help
	  It support different accelerometer sensor.
	  If this option is set,
	  it will support
	  BMA255 Accelerometer in BMC150.
```

## M250_Nougat_Kernel/kernel-3.18/drivers/misc/mediatek/chargepump/Kconfig
```kconfig
config	CUSTOM_KERNEL_CHARGEPUMP
	bool "chargepump Support"
	default n
	help
	  This feature Option is used for projects which using exteranl backlight driver
	  if you want to  external backlight driver, please turn on this feature first,
	  then LED driver call external backlight driver API.
	  Also this feature related to flashlight and DSV driver.

config LEDS_RT4832
	bool "RT4832 Support"
	default n
	help
	  charge pump driver for external backlight and flashlight
	  it support DSV, flashlight, LED module.
	  if you want to use external backlight driver moulde on your project,
	  please turn on chargepump option also.

config LEDS_RT4832_LV5
	bool "RT4832 Support"
	default n
	help
	  charge pump driver for external backlight and flashlight
	  it support DSV, flashlight, LED module.
	  if you want to use external backlight driver moulde on your project,
	  please turn on chargepump option also.

config LEDS_RT4832_SF3
	bool "RT4832 Support"
	default n
	help
	  charge pump driver for external backlight and flashlight
	  it support DSV, flashlight, LED module.
	  if you want to use external backlight driver moulde on your project,
	  please turn on chargepump option also.

config LEDS_RT4832_K6PNA
	bool "RT4832 ph1 Support"
	default n
	help
	  charge pump driver for external backlight and flashlight
	  it support DSV, flashlight, LED module.
	  if you want to use external backlight driver moulde on your project,
	  please turn on chargepump option also.

config LEDS_RT4832_PH1
	bool "RT4832 ph1 Support"
	default n
	help
	  charge pump driver for external backlight and flashlight
	  it support DSV, flashlight, LED module.
	  if you want to use external backlight driver moulde on your project,
	  please turn on chargepump option also.

config LGD_INCELL_LG4894_HD_K6PNA
	bool "LG4894_LV5 Support"
	default n
	help
	  charge pump driver for external backlight and flashlight
	  it support DSV, flashlight, LED module.
	  if you want to use external backlight driver moulde on your project,
	  please turn on chargepump option also.

config LGD_INCELL_LG4894_HD_LV5
	bool "LG4894_LV5 Support"
	default n
	help
	  charge pump driver for external backlight and flashlight
	  it support DSV, flashlight, LED module.
	  if you want to use external backlight driver moulde on your project,
	  please turn on chargepump option also.

config LGD_INCELL_TD4100_HD_SF3
	bool "TD4100_SF3 Support"
	default n
	help
	  charge pump driver for external backlight and flashlight
	  it support DSV, flashlight, LED module.
	  if you want to use external backlight driver moulde on your project,
	  please turn on chargepump option also.

config LEDS_RT8542
	bool "RT8542 Support"
	default n
	help
	  charge pump driver for external backlight and flashlight
	  it support DSV, flashlight, LED module.
	  if you want to use external backlight driver moulde on your project,
	  please turn on chargepump option also.

config DSV_SM5107
	bool "SM5107 Support"
	default n
	help
	  charge pump driver for external backlight and flashlight
	  it support DSV, flashlight, LED module.
	  if you want to use external backlight driver moulde on your project,
	  please turn on chargepump option also.

config LEDS_LM3648
	bool "LM3648 LED"
	default n
config LEDS_LM3632
	bool "LM3632 LED"
	default n

config LEDS_DW8767
	bool "DW8767 LED"
	default n
```

## M250_Nougat_Kernel/kernel-3.18/drivers/misc/mediatek/gyroscope/lsm6dsegy-new/Kconfig
```kconfig
config MTK_LSM6DSE_GYRO
        bool "LSM6DSEG for MediaTek package"
        default n
	help
        It support different gyroscope sensor.
        If this option is set,
	  	it will support
         MTK_LSM6DSE gyroscope.
```

## M250_Nougat_Kernel/kernel-3.18/drivers/misc/mediatek/lcm/Kconfig
```kconfig
config MTK_LCM
	bool CONFIG_MTK_LCM
	default n
	help
	  LCM driver

config CUSTOM_KERNEL_LCM
	string "CUSTOM_KERNEL_LCM"
	help
	  To choose kernel LCM driver name

config MTK_LCM_DEVICE_TREE_SUPPORT
	bool "MTK_LCM_DEVICE_TREE_SUPPORT"
	help
	  Decide whether to support LCM device tree based configuration.
	  This feature requires the connection between display driver and LCM devices.
	  Please also turn on MTK_LCM_DEVICE_TREE_SUPPORT in ProjectConfig.mk.

source "drivers/misc/mediatek/lcm/lg4894_hd720_dsi_vdo/Kconfig"
source "drivers/misc/mediatek/lcm/td4100_hd720_dsi_vdo_lgd_sf3/Kconfig"
source "drivers/misc/mediatek/lcm/td4100_hd720_dsi_vdo_tovis_lv5/Kconfig"
source "drivers/misc/mediatek/lcm/td4100_hd720_dsi_vdo_tovis_lv7/Kconfig"
```

## M250_Nougat_Kernel/kernel-3.18/drivers/misc/mediatek/lcm/td4100_hd720_dsi_vdo_tovis_lv7/Kconfig
```kconfig
config TOVIS_INCELL_TD4100_HD_LV7
        bool "Enable TOVIS TD4100 INCELL HD panel for LV7"
        default n
```

## M250_Nougat_Kernel/kernel-3.18/drivers/misc/mediatek/tilt_detector_sensor/Kconfig
```kconfig
config CUSTOM_KERNEL_TILT_DETECTOR_SENSOR
	bool "CUSTOM_KERNEL_TILT_DETECTOR_SENSOR"
	help
	  Kernel space tilt detector sensor driver.
source "drivers/misc/mediatek/tilt_detector_sensor/tiltdetecthub/Kconfig"

config CUSTOM_KERNEL_SIGNIFICANT_MOTION
	bool "CUSTOM_KERNEL_SIGNIFICANT_MOTION"
	help
	  Kernel space sigificant motion sensor driver.
```

## M250_Nougat_Kernel/kernel-3.18/drivers/usb/lge/Kconfig
```kconfig
menu "USB Host drivers for LGE Model"

config LGE_USB_HOST_SUPPORT_LIST_HID
	bool "Enable LGE usb host compatible hid devices list"
	default n
	select HID
	select HIDRAW
	select UHID
	select HID_GENERIC
#	select HID_A4TECH
#	select HID_ACRUX
#	select HID_ACRUX_FF
	select HID_APPLE
#	select HID_APPLEIR
	select HID_AUREAL
	select HID_BELKIN
	select HID_CHERRY
	select HID_CHICONY
	select HID_PRODIKEYS
#	select HID_CP2112
	select HID_CYPRESS
	select HID_DRAGONRISE
	select DRAGONRISE_FF
	select HID_EMS_FF
	select HID_ELECOM
#	select HID_ELO
	select HID_EZKEY
	select HID_HOLTEK
#	select HOLTEK_FF
#	select HID_GT683R
#	select HID_HUION
	select HID_KEYTOUCH
	select HID_KYE
	select HID_UCLOGIC
	select HID_WALTOP
	select HID_GYRATION
#	select HID_ICADE
	select HID_TWINHAN
	select HID_KENSINGTON
	select HID_LCPOWER
#	select HID_LENOVO
	select HID_LOGITECH
	select HID_LOGITECH_DJ
#	select HID_LOGITECH_HIDPP
	select LOGITECH_FF
	select LOGIRUMBLEPAD2_FF
	select LOGIG940_FF
	select LOGIWHEELS_FF
	select HID_MAGICMOUSE
	select HID_MICROSOFT
	select HID_MONTEREY
	select HID_MULTITOUCH
#	select HID_NTRIG
	select HID_ORTEK
	select HID_PANTHERLORD
	select PANTHERLORD_FF
#	select HID_PENMOUNT
	select HID_PETALYNX
	select HID_PICOLCD
#	select HID_PICOLCD_FB
#	select HID_PICOLCD_LEDS
	select HID_PRIMAX
	select HID_PS3REMOTE
	select HID_ROCCAT
	select HID_SAITEK
	select HID_SAMSUNG
	select HID_SONY
	select HID_SPEEDLINK
	select HID_STEELSERIES
	select HID_SUNPLUS
#	select HID_RMI
	select HID_GREENASIA
	select GREENASIA_FF
	select HID_SMARTJOYPLUS
	select SMARTJOYPLUS_FF
	select HID_TIVO
	select HID_TOPSEED
	select HID_THINGM
	select HID_THRUSTMASTER
	select THRUSTMASTER_FF
	select HID_WACOM
	select HID_WACOM_POWER_SUPPLY
	select HID_WIIMOTE
	select HID_WIIMOTE_EXT
#	select HID_XINMO
#	select HID_ZEROPLUS
	select HID_ZYDACRON
#	select HID_SENSOR_HUB
	select USB_HID
	select USB_HIDDEV
	help
		hid devices include specials, change to yes here to support high
		compatiblily usb host devices.

config LGE_USB_HOST_SUPPORT_LIST_NETWORK
	bool "Enable LGE usb host compatible network devices list"
	default n
	select USB_USBNET
	select USB_CATC
#	select USB_KAWETH
	select USB_PEGASUS
	select USB_RTL8150
	select USB_RTL8152
	select USB_NET_AX8817X
	select USB_NET_AX88179_178A
	select USB_NET_CDCETHER
	select USB_NET_CDC_EEM
	select USB_NET_CDC_NCM
	select USB_NET_CDC_MBIM
	select USB_NET_DM9601
	select USB_NET_SR9700
	select USB_NET_SR9800
	select USB_NET_SMSC75XX
	select USB_NET_SMSC95XX
	select USB_NET_GL620A
	select USB_NET_NET1080
	select USB_NET_PLUSB
	select USB_NET_MCS7830
	select USB_NET_RNDIS_HOST
	select USB_NET_CDC_SUBSET
	select USB_ALI_M5632
	select USB_AN2720
	select USB_BELKIN
	select USB_ARMLINUX
	select USB_EPSON2888
	select USB_KC2190
	select USB_NET_ZAURUS
	select USB_NET_CX82310_ETH
	select USB_NET_KALMIA
	select USB_NET_QMI_WWAN
	select USB_HSO
	select USB_NET_INT51X1
	select USB_IPHETH
	select USB_SIERRA_NET
	select USB_VL600
	select MSM_RMNET_USB
	help
	  network devices include specials, change to yes here to support high
	  compatiblily usb host devices.

config LGE_USB_HOST_SUPPORT_LIST_INPUT
	bool "Enable LGE usb host compatible input devices list"
	default n
#	select INPUT_MOUSEDEV
#	select INPUT_JOYDEV
	select INPUT_EVDEV
#	select INPUT_MOUSE
	select MOUSE_APPLETOUCH
	select MOUSE_BCM5974
#	select MOUSE_SYNAPTICS_USB
	select INPUT_JOYSTICK
#	select JOYSTICK_ANALOG
#	select JOYSTICK_A3D
#	select JOYSTICK_ADI
#	select JOYSTICK_COBRA
#	select JOYSTICK_GF2K
#	select JOYSTICK_GRIP
#	select JOYSTICK_GRIP_MP
#	select JOYSTICK_GUILLEMOT
#	select JOYSTICK_INTERACT
#	select JOYSTICK_SIDEWINDER
#	select JOYSTICK_TMDC
	select JOYSTICK_IFORCE
	select JOYSTICK_IFORCE_USB
#	select JOYSTICK_WARRIOR
#	select JOYSTICK_MAGELLAN
#	select JOYSTICK_SPACEORB
#	select JOYSTICK_SPACEBALL
#	select JOYSTICK_STINGER
#	select JOYSTICK_TWIDJOY
#	select JOYSTICK_ZHENHUA
#	select JOYSTICK_AS5011
#	select JOYSTICK_JOYDUMP
	select JOYSTICK_XPAD
	select JOYSTICK_XPAD_FF
	select JOYSTICK_XPAD_LEDS
	select INPUT_TABLET
	select TABLET_USB_ACECAD
	select TABLET_USB_AIPTEK
	select TABLET_USB_GTCO
	select TABLET_USB_HANWANG
	select TABLET_USB_KBTAB
	select TABLET_USB_WACOM
	help
		network devices include specials, change to yes here to support high
		compatiblily usb host devices.

config LGE_USB_HOST_SUPPORT_LIST_SOUND
	bool "Enable LGE usb host compatible sound devices list"
	default n
	select SND_USB_AUDIO
	select SND_USB_UA101
	select SND_USB_CAIAQ
	select SND_USB_6FIRE
	help
		sound devices include specials, change to yes here to support high
		compatiblily usb host devices.

config LGE_USB_HOST_SUPPORT_LIST_VIDEO
	bool "Enable LGE usb host compatible video devices list"
	default n
	select MEDIA_SUPPORT
	select MEDIA_CAMERA_SUPPORT
	select MEDIA_CONTROLLER
	select VIDEO_V4L2_SUBDEV_API
	select MEDIA_USB_SUPPORT
	select V4L_PLATFORM_DRIVERS
	select USB_VIDEO_CLASS
	select USB_VIDEO_CLASS_INPUT_EVDEV
	help
		sound devices include specials, change to yes here to support high
		compatiblily usb host devices

config LGE_USB_HOST_SUPPORT_LIST_STORAGE
	bool "Enable LGE usb host compatible storage devices list"
	default n
	select SCSI
	select BLK_DEV_SD
	select SCSI_SCAN_ASYNC
	select USB_STORAGE
	select USB_STORAGE_DEBUG
	select USB_STORAGE_REALTEK
	select USB_STORAGE_DATAFAB
	select USB_STORAGE_FREECOM
	select USB_STORAGE_ISD200
	select USB_STORAGE_USBAT
	select USB_STORAGE_SDDR09
	select USB_STORAGE_SDDR55
	select USB_STORAGE_JUMPSHOT
	select USB_STORAGE_ALAUDA
	select USB_STORAGE_ONETOUCH
	select USB_STORAGE_KARMA
	select USB_STORAGE_CYPRESS_ATACB
	select USB_STORAGE_ENE_UB6250
	select USB_UAS
	help
		sound devices include specials, change to yes here to support high
		compatiblily usb host devices

config LGE_USB_HOST_SUPPORT_LIST_SERIAL
	bool "Enable LGE usb host compatible storage devices list"
	default n
	select USB_SERIAL
	select USB_SERIAL_GENERIC
	select USB_SERIAL_FTDI_SIO
	select USB_SERIAL_PL2303
	help
		serial devices include specials, change to yes here to support high
		compatiblily usb host devices

endmenu
```
