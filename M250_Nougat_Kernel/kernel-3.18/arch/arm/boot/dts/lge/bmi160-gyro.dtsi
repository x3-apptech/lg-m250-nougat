/*
 * LG Electronics lsm6ds3-acc sensor device tree source
 *
 * Copyright (c) 2016 LG Electronics Co., Ltd.
 *              http://www.lge.com
 *
 */

cust_gyro@69 {
	compatible = "mediatek,bmi160_gyro";
	reg = <0x69>;
	status = "okay";
	i2c_num = <3>;
	i2c_addr = <0x69 0 0 0>;
	direction = <4>;
	power_id = <0xffff>;
	power_vol = <0>;
	firlen = <0>;
	is_batch_supported = <0>;
};

